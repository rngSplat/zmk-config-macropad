## config/boards/shields/VOID16/Kconfig.defconfig
```kconfig
# Copyright (c) 2020 The ZMK Contributors
# SPDX-License-Identifier: MIT

if SHIELD_VOID16

config ZMK_KEYBOARD_NAME
    default "VOID16"

config ZMK_USB
    default y

config ZMK_KSCAN_MATRIX_POLLING
    default y

endif
```

left_encoder: encoder_left {
        compatible = "alps,ec11";
        label = "LEFT_ENCODER";
        a-gpios = <0 (GPIO_ACTIVE_HIGH | GPIO_PULL_UP)>;
        b-gpios = <1 (GPIO_ACTIVE_HIGH | GPIO_PULL_UP)>;
        resolution = <4>;
    };